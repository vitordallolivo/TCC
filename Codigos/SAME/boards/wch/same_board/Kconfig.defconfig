## Codigos/SAME/boards/wch/same_board/Kconfig.defconfig
```kconfig
# Copyright (c) 2026 SAME
# SPDX-License-Identifier: Apache-2.0
if BOARD_SAME_BOARD

config NET_L2_ETHERNET
	default y

endif # BOARD_SAME_BOARD
```

## Codigos/SAME/boards/wch/same_board/Kconfig.same_board
```kconfig
# SPDX-License-Identifier: Apache-2.0
config BOARD_SAME_BOARD
	select SOC_CH32V307

if BOARD_SAME_BOARD
endif
```

## Codigos/SAME/boards/wch/same_board/board.yml
```yaml
board:
  name: same_board
  full_name: SAME Board
  vendor: wch
  socs:
    - name: ch32v307
```

## Codigos/SIBA/boards/wch/siba_board/Kconfig.defconfig
```kconfig
# Copyright (c) 2026 SIBA
# SPDX-License-Identifier: Apache-2.0
if BOARD_SIBA_BOARD

config NET_L2_ETHERNET
	default y

endif # BOARD_SIBA_BOARD
```

## Codigos/SPMM/boards/wch/spmm_board/Kconfig.defconfig
```kconfig
# Copyright (c) 2026 SPMM
# SPDX-License-Identifier: Apache-2.0
if BOARD_SPMM_BOARD

config NET_L2_ETHERNET
	default y

endif # BOARD_SPMM_BOARD
```

## Codigos/SPMM/boards/wch/spmm_board/Kconfig.spmm_board
```kconfig
# SPDX-License-Identifier: Apache-2.0
config BOARD_SPMM_BOARD
	select SOC_CH32V307

if BOARD_SPMM_BOARD
endif
```

## Codigos/SPMM/boards/wch/spmm_board/board.yml
```yaml
board:
  name: spmm_board
  full_name: SPMM Board
  vendor: wch
  socs:
    - name: ch32v307
```

## firmware/Kconfig
```kconfig
mainmenu "SIBA Firmware"

source "Kconfig.zephyr"

menu "SIBA application"

config SIBA_NET_STATUS_UART
	bool "Imprime status de rede e telemetria na UART a cada 5 s"
	default n
	help
	  Quando habilitado, um worker na siba_wq imprime a cada 5 s:
	  status da conexão, IP configurado, células de carga, bateria,
	  rpm e error_code. Útil para bancada sem a GUI conectada.

config SIBA_RELAY_PRECHARGE_MS
	int "Tempo de pré-carga antes de fechar o relé de potência (ms)"
	default 5000
	range 0 60000
	help
	  Intervalo entre fechar o relé de pré-carga (PB13) e fechar o de
	  potência (PB12). É o tempo dado aos capacitores do barramento do
	  ESC para carregarem através do resistor de pré-carga, limitando a
	  corrente de inrush no fechamento da potência.

	  Com o resistor de pré-carga de 100 ohm dimensionado na metodologia
	  e 2000 uF de capacitância equivalente do ESC, a constante de tempo
	  é de 0,2 s; o critério de projeto (regime permanente em cinco
	  constantes) daria 1 s. O padrão de 5000 ms é uma margem deliberada
	  sobre esse critério, a ser refinada em bancada.

	  Curto demais e o relé de potência fecha sobre capacitor ainda
	  descarregado, com o pico de inrush que a pré-carga existe para
	  evitar; longo demais só atrasa a partida. A sequência bloqueia a
	  fila de trabalho durante todo o intervalo.

	  Quem lê este valor é o Battery_Manager, que o passa ao HAL — o HAL
	  não decide tempo de bancada.

config SIBA_TEST_SHELL
	bool "Comandos de diagnóstico de bancada no shell"
	depends on SHELL
	default y
	help
	  Compila lib/SYS/Test_Shell.c, que registra no shell os comandos de
	  bancada: telemetria, sensores crus e calibrados, lista de erros,
	  armar/desarmar, parada de emergência, taração e calibração de
	  células de carga, parâmetros de bateria e acionamento do relé.

	  É ferramenta de desenvolvimento e ensaio, NÃO faz parte do produto
	  final: dá acesso direto ao ESC e aos relés pela UART, sem passar
	  pela aplicação de supervisão nem pelo protocolo de rede, e sem
	  autenticação de nenhum tipo.

	  Para tirar do produto, desabilite também CONFIG_SHELL — sem isso o
	  interpretador continua ocupando flash, só que sem comandos da
	  aplicação.

endmenu
```

## firmware/boards/wch/siba_board/Kconfig.siba_board
```kconfig
# SPDX-License-Identifier: Apache-2.0
config BOARD_SIBA_BOARD
	select SOC_CH32V307

if BOARD_SIBA_BOARD
endif
```

## firmware/boards/wch/siba_board/board.yml
```yaml
board:
  name: siba_board
  full_name: SIBA Board
  vendor: wch
  socs:
    - name: ch32v307
```

## firmware/drivers/adc/Kconfig
```kconfig
# SPDX-License-Identifier: Apache-2.0

config ADC_CH32V307
	bool "Driver ADC para CH32V307 (WCH) com DMA circular"
	default y
	depends on DT_HAS_WCH_ADC_ENABLED
	select ADC
	help
	  Driver ADC para CH32V307VTC6.
	  Usa DMA1 Canal 1 em modo circular + scan contínuo.
	  Suporta até 16 canais configurados via adc_channel_setup().
	  Implementa adc_read() síncrono e adc_read_async() (com CONFIG_ADC_ASYNC).
```
